## gadget/configs/chippro_defconfig
```kconfig
BR2_arm=y
BR2_cortex_a8=y
BR2_ARM_INSTRUCTIONS_THUMB2=y
BR2_DL_DIR="/opt/dlcache"
BR2_BACKUP_SITE="http://sources.buildroot.net/"
BR2_KERNEL_MIRROR="http://www.kernel.org/pub/"
BR2_LUAROCKS_MIRROR="http://luarocks.org/repositories/rocks"
BR2_CPAN_MIRROR="http://search.cpan.org/CPAN"
BR2_PACKAGE_OVERRIDE_FILE="${BR2_EXTERNAL_GADGETOS_PATH}/local.mk"
BR2_TOOLCHAIN_EXTERNAL=y
BR2_TARGET_OPTIMIZATION="-pipe"
BR2_TARGET_GENERIC_HOSTNAME="chip"
BR2_ROOTFS_DEVICE_CREATION_DYNAMIC_MDEV=y
BR2_TARGET_GENERIC_ROOT_PASSWD="root"
# BR2_TARGET_GENERIC_GETTY is not set
BR2_ROOTFS_USERS_TABLES="${BR2_EXTERNAL_GADGETOS_PATH}/board/nextthing/common/users_table.txt"
BR2_ROOTFS_OVERLAY="${BR2_EXTERNAL_GADGETOS_PATH}/board/nextthing/common/overlay"
BR2_ROOTFS_POST_BUILD_SCRIPT="${BR2_EXTERNAL_GADGETOS_PATH}/board/nextthing/common/scripts/post-build.sh"
BR2_ROOTFS_POST_FAKEROOT_SCRIPT="${BR2_EXTERNAL_GADGETOS_PATH}/board/nextthing/common/scripts/post-fakeroot.sh"
BR2_ROOTFS_POST_IMAGE_SCRIPT="${BR2_EXTERNAL_GADGETOS_PATH}/board/nextthing/common/scripts/post-image.sh"
BR2_ROOTFS_POST_SCRIPT_ARGS="\"toshiba-slc\""
BR2_LINUX_KERNEL=y
BR2_LINUX_KERNEL_CUSTOM_GIT=y
BR2_LINUX_KERNEL_CUSTOM_REPO_URL="https://github.com/NextThingCo/linux"
BR2_LINUX_KERNEL_CUSTOM_REPO_VERSION="28e7e96f40715d684d420df0e2f83baa73ed68a3"
BR2_LINUX_KERNEL_PATCH="${BR2_EXTERNAL_GADGETOS_PATH}/board/nextthing/chippro/patches/linux/"
BR2_LINUX_KERNEL_USE_CUSTOM_CONFIG=y
BR2_LINUX_KERNEL_CUSTOM_CONFIG_FILE="${BR2_EXTERNAL_GADGETOS_PATH}/board/nextthing/chippro/configs/linux.config"
BR2_LINUX_KERNEL_LZO=y
BR2_LINUX_KERNEL_DTS_SUPPORT=y
BR2_LINUX_KERNEL_INTREE_DTS_NAME="ntc-gr8-crumb"
BR2_PACKAGE_BUSYBOX_CONFIG="${BR2_EXTERNAL_GADGETOS_PATH}/board/nextthing/common/configs/busybox.config"
BR2_PACKAGE_BUSYBOX_SHOW_OTHERS=y
BR2_PACKAGE_ALSA_UTILS=y
BR2_PACKAGE_ALSA_UTILS_AMIXER=y
BR2_PACKAGE_UBOOT_TOOLS=y
# BR2_PACKAGE_ALSA_LIB_RAWMIDI is not set
# BR2_PACKAGE_ALSA_LIB_ALISP is not set
BR2_PACKAGE_CA_CERTIFICATES=y
BR2_PACKAGE_LIBCAP=y
BR2_PACKAGE_BIND=y
# BR2_PACKAGE_BIND_SERVER is not set
BR2_PACKAGE_BIND_TOOLS=y
BR2_PACKAGE_BLUEZ5_UTILS=y
BR2_PACKAGE_BLUEZ5_UTILS_CLIENT=y
BR2_PACKAGE_CONNMAN=y
# BR2_PACKAGE_CONNMAN_ETHERNET is not set
BR2_PACKAGE_CONNMAN_WIFI=y
BR2_PACKAGE_CONNMAN_BLUETOOTH=y
BR2_PACKAGE_CONNMAN_LOOPBACK=y
BR2_PACKAGE_CONNMAN_CLIENT=y
BR2_PACKAGE_DHCPCD=y
# BR2_PACKAGE_DNSMASQ_TFTP is not set
BR2_PACKAGE_IPROUTE2=y
BR2_PACKAGE_IW=y
BR2_PACKAGE_NTP=y
BR2_PACKAGE_OPENSSH=y
BR2_PACKAGE_WGET=y
BR2_PACKAGE_WPA_SUPPLICANT_AP_SUPPORT=y
BR2_PACKAGE_WPA_SUPPLICANT_EAP=y
BR2_PACKAGE_WPA_SUPPLICANT_HOTSPOT=y
BR2_PACKAGE_WPA_SUPPLICANT_CLI=y
BR2_PACKAGE_WPA_SUPPLICANT_PASSPHRASE=y
BR2_PACKAGE_WPA_SUPPLICANT_DBUS_INTROSPECTION=y
BR2_PACKAGE_CGROUPFS_MOUNT=y
BR2_PACKAGE_DOCKER_ENGINE_DRIVER_DEVICEMAPPER=y
BR2_PACKAGE_KMOD=y
BR2_PACKAGE_KMOD_TOOLS=y
BR2_PACKAGE_UTIL_LINUX_NOLOGIN=y
BR2_PACKAGE_NANO=y
BR2_TARGET_UBOOT=y
BR2_TARGET_UBOOT_BUILD_SYSTEM_KCONFIG=y
BR2_TARGET_UBOOT_CUSTOM_GIT=y
BR2_TARGET_UBOOT_CUSTOM_REPO_URL="https://github.com/nextthingco/chip-u-boot"
BR2_TARGET_UBOOT_CUSTOM_REPO_VERSION="ww/2016.01/next"
BR2_TARGET_UBOOT_BOARD_DEFCONFIG="chippro"
BR2_TARGET_UBOOT_FORMAT_CUSTOM=y
BR2_TARGET_UBOOT_FORMAT_CUSTOM_NAME="u-boot-dtb.bin"
BR2_TARGET_UBOOT_SPL=y
BR2_TARGET_UBOOT_SPL_NAME="u-boot-sunxi-with-spl.bin spl/sunxi-spl.bin"
BR2_TARGET_UBOOT_ENVIMAGE=y
BR2_TARGET_UBOOT_ENVIMAGE_SOURCE="${BR2_EXTERNAL_GADGETOS_PATH}/board/nextthing/common/uboot-env"
BR2_TARGET_UBOOT_ENVIMAGE_SIZE="0x400000"
BR2_PACKAGE_HOST_DTC=y
BR2_PACKAGE_HOST_SUNXI_TOOLS=y
BR2_PACKAGE_GADGET_BLUETOOTH_CONF=y
BR2_PACKAGE_GADGET_INITC=y
BR2_PACKAGE_GADGET_INIT_SCRIPTS=y
BR2_PACKAGE_GADGET_INIT_SCRIPTS_USB_GADGET=y
BR2_PACKAGE_GADGET_SETUP_SSH_KEY=y
BR2_PACKAGE_GADGET_TOOLS=y
BR2_PACKAGE_HOST_DTC_OVERLAY=y
BR2_PACKAGE_RTL8723BS_MP_DRIVER=y
BR2_PACKAGE_RTL8723DS_MP_DRIVER=y
BR2_PACKAGE_RTL8723DS_BT=y
BR2_PACKAGE_HOST_CHIP_MTD_UTILS=y
BR2_PACKAGE_GADGET_UPDATE=y
BR2_PACKAGE_HOST_CHIP_NAND_SCRIPTS=y
```
